## CMakeLists.txt
```
cmake_minimum_required(VERSION 3.20.0)

list(APPEND BOARD_ROOT ${CMAKE_CURRENT_SOURCE_DIR}/..)

find_package(Zephyr REQUIRED)
project(my_zephyr_app)
target_sources(app PRIVATE src/main.cpp)
add_subdirectory(drivers/our_driver)
```

## Kconfig
```
menuconfig LED_SUBSYSTEM
    bool "LED Subsystem"
    default y
    help
        Enable the LED subsystem and its configuration options.

if LED_SUBSYSTEM

choice
    prompt "LED blink sleep time"
    default BLINK_SLEEP_TIME_1S
    help
        Choose how long the LED stays in each state between toggles.

config BLINK_SLEEP_TIME_250MS
    bool "250ms (very fast)"

config BLINK_SLEEP_TIME_500MS
    bool "500ms (fast)"

config BLINK_SLEEP_TIME_1S
    bool "1s (medium)"

config BLINK_SLEEP_TIME_2S
    bool "2s (slow)"

endchoice

# Derived (promptless / hidden) value consumed by the application code.
config BLINK_SLEEP_TIME_MS
    int
    default 250 if BLINK_SLEEP_TIME_250MS
    default 500 if BLINK_SLEEP_TIME_500MS
    default 1000 if BLINK_SLEEP_TIME_1S
    default 2000 if BLINK_SLEEP_TIME_2S
    default 1000
    help
        Sleep time in milliseconds, derived from the choice above.

menuconfig LED_ADVANCED
    bool "Advanced LED settings"
    help
        Enable advanced tuning options for the LED.

if LED_ADVANCED

config LED_BRIGHTNESS
    int "LED brightness (0-100)"
    range 0 100
    default 100
    help
        LED brightness as a percentage.

config LED_FADE_DURATION_MS
    int "LED fade duration (ms)"
    range 0 5000
    default 500
    help
        Duration of the LED fade transition, in milliseconds.

menu "Expert settings"
    visible if LED_ADVANCED

config LED_DEBUGGING
    bool "Enable LED debugging"
    help
        Emit extra debug logging for the LED subsystem.

config CUSTOM_BLINK_PATTERN
    bool "Custom blink pattern"
    help
        Use a custom blink pattern instead of the fixed toggle.

endmenu

endif # LED_ADVANCED

endif # LED_SUBSYSTEM



config APP_HEARTBEAT_PERIOD_MS
    int "Heart Beat led interval"
    default 500 
    range 100 2000
    help
        Time between hearbeats.

rsource "drivers/our_driver/Kconfig"
source "Kconfig.zephyr"
```

## prj.conf
```kconfig
CONFIG_GPIO=y
CONFIG_LOG=y
CONFIG_SENSOR=y

# Shell
CONFIG_SHELL=y
CONFIG_SHELL_TAB=y
CONFIG_SHELL_TAB_AUTOCOMPLETION=y
CONFIG_SHELL_HISTORY=y
CONFIG_SHELL_LOG_BACKEND=y
```

## app.overlay
```dts
/ {
    aliases {
        app-led = &green_led_2;
    };

    led_sensor: led_sensor {
        compatible = "our,driver";
        led-gpios = <&gpioa 5 GPIO_ACTIVE_HIGH>; /* LD2 */
        status = "okay";
    };
};
```

## dts/bindings/our,driver.yaml
```yaml
description: Our custom sensor driver binding (on-board LED)
compatible: "our,driver"
include: base.yaml

properties:
  led-gpios:
    type: phandle-array
    required: true
```

## src/main.cpp
```c
#include <zephyr/drivers/sensor.h>
#include <zephyr/kernel.h>
#include <zephyr/logging/log.h>

/* Custom extension API implemented in drivers/our_driver/our_driver.c */
extern "C" int our_driver_set_count(const struct device *dev, uint32_t count);

LOG_MODULE_REGISTER(main, LOG_LEVEL_INF);

int main(void)
{
    const struct device *dev = DEVICE_DT_GET_ANY(our_driver);
    struct sensor_value val;

    if (!device_is_ready(dev)) {
        LOG_ERR("LED sensor not ready");
        return -ENODEV;
    }

    while (1) {
        sensor_sample_fetch(dev);                        /* LED on */
        LOG_INF("LED on");
        k_msleep(CONFIG_APP_HEARTBEAT_PERIOD_MS);

        sensor_channel_get(dev, SENSOR_CHAN_ALL, &val);  /* LED off */
        LOG_INF("LED off (state was %d, fetch count %d)", val.val1, val.val2);
        k_msleep(CONFIG_APP_HEARTBEAT_PERIOD_MS);

        if (val.val2 >= 5) {
            our_driver_set_count(dev, 0);                /* custom API */
            LOG_INF("Fetch count reset");
        }
    }
    return 0;
}
```
