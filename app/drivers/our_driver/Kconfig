## app/drivers/our_driver/Kconfig
```kconfig
menuconfig OUR_DRIVER
    bool "Our Custom Driver"
    default y
    depends on DT_HAS_OUR_DRIVER_ENABLED # Only if HW is present in the DT
    depends on SENSOR
    select GPIO                          # Auto-pulls dependencies
    help
      Enable the custom LED sensor driver
```

## boards/my_board_i5_t2/Kconfig.defconfig
```kconfig
# NUCLEO-64 F401RE board configuration

# Copyright (c) 2016 Linaro Limited.
# Copyright (c) 2019 Centaur Analytics, Inc
# SPDX-License-Identifier: Apache-2.0

if BOARD_MY_BOARD_I5_T2

config BOARD_LATE_INIT_HOOK
	default y

endif # BOARD_MY_BOARD_I5_T2
```

## boards/my_board_i5_t2/Kconfig.my_board_i5_t2
```kconfig
# Copyright (c) 2016 Linaro Limited.
# SPDX-License-Identifier: Apache-2.0

config BOARD_MY_BOARD_I5_T2
	select SOC_STM32F401XE
```

## boards/my_board_i5_t2/board.yml
```yaml
board:
  name: my_board_i5_t2
  full_name: my own scratch Nucleo F401RE
  vendor: st_rafay
  socs:
    - name: stm32f401xe
```

## boards/our_board_i5_t1/Kconfig.our_board_i5_t1
```kconfig
# Copyright (c) 2016 Linaro Limited.
# SPDX-License-Identifier: Apache-2.0

config BOARD_OUR_BOARD_I5_T1
	select SOC_STM32F401XE
```

## boards/our_board_i5_t1/board.yml
```yaml
board:
  name: our_board_i5_t1
  full_name: our own Nucleo F401RE
  vendor: st_rafay
  socs:
    - name: stm32f401xe
```
